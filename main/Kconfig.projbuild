## main/Kconfig.projbuild
```kconfig
menu "Ground Station Configuration"

    config GS_MAV_SYSID
        int "System id of MAVLINK"
        default 1
        help 
            Don't Change the Number

    config GS_MAV_BRIDGE_COMPID
        int "Component id of MAVLINK"
        default 198
        help 
            MAV_COMP_ID_PAIRING_MANAGER : 198

    config GS_MAV_DRONE_COMPID
        int "Component id of MAVLINK"
        default 1
        help 
            Don't Change the Number
        
    config GS_ESPNOW_CHANNEL
        int "ESPNOW  Channel"
        default 6
        help 
            Bridge channel equal the Drone Channel 

    config GS_BRIDGE_MAC
        string "Bridge MAC Address"
        default "1C:DB:D4:AE:82:04"
        help
            Format: XX:XX:XX:XX:XX:XX

    config GS_DRONE_MAC
        string "Drone MAC Address"
        default "B0:CB:D8:D7:2E:B0"
        help
            Format: XX:XX:XX:XX:XX:XX

    config GS_TARGET_IP
        string "Target IP Address"
        default "192.168.4.2"
        help
            IP address of the QGC host.

    config GS_UDP_PORT
        int "UDP Port for QGC"
        default 14550
        help
            QGroundControl standard port is 14550.

    config GS_WIFI_SSID
        string "Soft-AP SSID"
        default "Ryu_ESP32_Drone"
        help
            The SSID of the Access Point.
            
    config GS_WIFI_PASSWORD
        string "Soft-AP Password"
        default "80044999"
        help
            Password for the Access Point.
endmenu
```

## sdkconfig.defaults
```kconfig
# Ground Station v2.0 SDK Configuration

# Wi-Fi 설정
CONFIG_GS_WIFI_SSID="GroundStation_AP"
CONFIG_GS_WIFI_PASSWORD="groundstation2024"
CONFIG_GS_ESPNOW_CHANNEL=6

# MAVLink 설정
CONFIG_GS_MAVLINK_SYSTEM_ID=1
CONFIG_GS_MAVLINK_COMPONENT_ID=1
CONFIG_GS_MAVLINK_TARGET_SYSTEM=1
CONFIG_GS_MAVLINK_TARGET_COMPONENT=1

# 메모리 설정
CONFIG_SPIRAM=y
CONFIG_SPIRAM_USE_CAPS_ALLOC=y
CONFIG_SPIRAM_USE_MALLOC=y

# ESP32S3 전용 기능
CONFIG_ESP32S3_DEFAULT_CPU_FREQ_240=y
CONFIG_ESP32S3_DATA_CACHE_64KB=y
CONFIG_ESP32S3_INSTRUCTION_CACHE_32KB=y

# USB Serial/JTAG
CONFIG_ESP_CONSOLE_USB_SERIAL_JTAG=y

# Wi-Fi 설정
CONFIG_ESP_WIFI_ENABLED=y
CONFIG_ESP_WIFI_SOFTAP_SUPPORT=y
CONFIG_ESP_WIFI_ESPNOW_ENABLED=y

# FreeRTOS 설정
CONFIG_FREERTOS_HZ=1000
CONFIG_FREERTOS_THREAD_LOCAL_STORAGE_POINTERS=1

# 로그 설정
CONFIG_LOG_DEFAULT_LEVEL_INFO=y
CONFIG_LOG_MAXIMUM_LEVEL_INFO=y

# 컴포넌트 설정
CONFIG_MAVLINK_ENABLED=y
CONFIG_LED_STRIP_ENABLED=y

# OTA 설정
CONFIG_ESP_HTTPS_OTA=y
CONFIG_ESP_HTTP_CLIENT=y
```
